## src/ble-mesh/common-components/rgb_control/Kconfig
```kconfig
menu "BLE Mesh RGB control"
    config BLE_MESH_RGB_CONTROL_SERVER
        bool "Enable RGB control server"
        default y
        help
            This allows other devices to control RGB on this device.
    config BLE_MESH_RGB_CONTROL_CLIENT
        bool "Enable RGB control client"
        default y
        help
            This allows to control RGB on other devices.
endmenu
```

## src/ble-mesh/mesh-firmware/main/Kconfig
```kconfig
menu "Mesh configuration"
    orsource "$IDF_PATH/examples/common_components/env_caps/$IDF_TARGET/Kconfig.env_caps"
    config SERIAL_TX_GPIO
        int "Serial TX GPIO number"
        range ENV_GPIO_RANGE_MIN ENV_GPIO_OUT_RANGE_MAX
        default 42 if IDF_TARGET_ESP32S3
        default 17
        help
            GPIO number (IOxx) to transmit information to bluetooth module.
            Some GPIOs are used for other purposes (flash connections, etc.) and cannot be used.
    
    config SERIAL_RX_GPIO
        int "Serial RX GPIO number"
        range ENV_GPIO_RANGE_MIN ENV_GPIO_OUT_RANGE_MAX
        default 41 if IDF_TARGET_ESP32S3
        default 14
        help
            GPIO number (IOxx) to receive information from bluetooth module.
            Some GPIOs are used for other purposes (flash connections, etc.) and cannot be used.
endmenu
```

## src/ble-mesh/mesh-firmware/sdkconfig.defaults
```kconfig
# General settings

CONFIG_ESPTOOLPY_FLASHSIZE_4MB=y
CONFIG_ESPTOOLPY_FLASHSIZE="4MB"

CONFIG_PARTITION_TABLE_CUSTOM=y
CONFIG_PARTITION_TABLE_CUSTOM_FILENAME="partitions.csv"
CONFIG_PARTITION_TABLE_FILENAME="partitions.csv"

# Fix warnings in esp-idf
CONFIG_COMPILER_DISABLE_GCC12_WARNINGS=y

# Override some defaults so BT stack is enabled
# by default in this example
CONFIG_BT_ENABLED=y
CONFIG_BT_CTRL_SCAN_DUPL_TYPE_DATA_DEVICE=y
CONFIG_BT_CTRL_BLE_MESH_SCAN_DUPL_EN=y
CONFIG_BT_GATTS_SEND_SERVICE_CHANGE_MANUAL=y
CONFIG_BT_BTU_TASK_STACK_SIZE=4512
CONFIG_BT_BLE_42_FEATURES_SUPPORTED=y

# Override some defaults of ESP BLE Mesh
CONFIG_BLE_MESH=y
CONFIG_BLE_MESH_NODE=y
CONFIG_BLE_MESH_PB_GATT=y
CONFIG_BLE_MESH_TX_SEG_MSG_COUNT=10
CONFIG_BLE_MESH_RX_SEG_MSG_COUNT=10

# BLE Mesh models
CONFIG_BLE_MESH_LIGHT_HSL_CLI=y
CONFIG_BLE_MESH_LIGHTING_SERVER=y
CONFIG_BLE_MESH_GENERIC_LOCATION_CLI=y
CONFIG_BLE_MESH_GENERIC_ONOFF_CLI=y

# Persistent BLE Mesh config
CONFIG_BLE_MESH_SETTINGS=y
CONFIG_BLE_MESH_STORE_TIMEOUT=0
CONFIG_BLE_MESH_SEQ_STORE_RATE=0
CONFIG_BLE_MESH_RPL_STORE_TIMEOUT=0
```

## src/ble-mesh/mesh-firmware/sdkconfig.defaults.esp32c3
```kconfig
CONFIG_IDF_TARGET="esp32c3"
# Serial communication
CONFIG_SERIAL_TX_GPIO=10
CONFIG_SERIAL_RX_GPIO=1
```

## src/ble-mesh/mobile-device/sdkconfig.defaults
```kconfig
# General settings
CONFIG_ESPTOOLPY_FLASHSIZE_4MB=y
CONFIG_ESPTOOLPY_FLASHSIZE="4MB"

CONFIG_PARTITION_TABLE_CUSTOM=y
CONFIG_PARTITION_TABLE_CUSTOM_FILENAME="partitions.csv"
CONFIG_PARTITION_TABLE_FILENAME="partitions.csv"

# Override some defaults so BT stack is enabled
# by default in this example
CONFIG_BT_ENABLED=y
CONFIG_BTDM_CTRL_MODE_BLE_ONLY=y
CONFIG_BTDM_CTRL_MODE_BR_EDR_ONLY=n
CONFIG_BTDM_CTRL_MODE_BTDM=n
CONFIG_CTRL_BTDM_MODEM_SLEEP=n
CONFIG_BTDM_SCAN_DUPL_TYPE_DATA_DEVICE=y
CONFIG_BTDM_BLE_MESH_SCAN_DUPL_EN=y
CONFIG_BT_GATTS_SEND_SERVICE_CHANGE_MANUAL=y
CONFIG_BT_BTU_TASK_STACK_SIZE=4512

# Override some defaults of ESP BLE Mesh
CONFIG_BLE_MESH=y
CONFIG_BLE_MESH_NODE=y
CONFIG_BLE_MESH_PB_GATT=y
CONFIG_BLE_MESH_TX_SEG_MSG_COUNT=10
CONFIG_BLE_MESH_RX_SEG_MSG_COUNT=10

# BLE Mesh models
CONFIG_BLE_MESH_GENERIC_ONOFF_CLI=y
CONFIG_BLE_MESH_LIGHT_HSL_CLI=y
CONFIG_BLE_MESH_LIGHTING_SERVER=y

# Persistent BLE Mesh config
CONFIG_BLE_MESH_SETTINGS=y
CONFIG_BLE_MESH_STORE_TIMEOUT=0
CONFIG_BLE_MESH_SEQ_STORE_RATE=0
CONFIG_BLE_MESH_RPL_STORE_TIMEOUT=0
```

## src/common-components/board/Kconfig
```kconfig
menu "Board configuration"
    orsource "$IDF_PATH/examples/common_components/env_caps/$IDF_TARGET/Kconfig.env_caps"
    config EXT_POWER_GPIO
        int "Externel power control GPIO number"
        range ENV_GPIO_RANGE_MIN ENV_GPIO_OUT_RANGE_MAX
        default 40
        help
            GPIO number (IOxx) to control external power.
endmenu
```

## src/common-components/distance_meter/Kconfig
```kconfig
menu "Distance Meter"
    config DISTANCE_FILTER_MAX_SIZE_DEFAULT
        int "Max distance filter size"
        range 0 65535
        default 8
        help
            Specify the maximum number of measurements from which the distance will be computed (can be overriden in code)
    
endmenu
```

## src/common-components/interactive-mesh-framework/Kconfig
```kconfig
menu "Interactive Mesh Framework"
    
    orsource "$IDF_PATH/examples/common_components/env_caps/$IDF_TARGET/Kconfig.env_caps"

    choice IMF_ROLE
        prompt "Mesh Role"
        default IMF_MOBILE_DEVICE
        help
            Mesh Role:

            "Mobile" device can move

            "Station" device does not move. It is stationary.

        config IMF_MOBILE_DEVICE
            bool "Mobile"
        config IMF_STATION_DEVICE
            bool "Station"
    endchoice
    
    config IMF_DEBUG_STATIC_DEVICES
        bool "Devices debugging - static values"
        default false
        help
            Devices will be only local and will not utilize BLE-Mesh. Special constructor is available to set initial values
    
    config IMF_SERIAL_TX_GPIO
        int "Serial TX GPIO number"
        range ENV_GPIO_RANGE_MIN ENV_GPIO_OUT_RANGE_MAX
        default 14
        help
            GPIO number (IOxx) to transmit information to bluetooth module.
            Some GPIOs are used for other purposes (flash connections, etc.) and cannot be used.
    
    config IMF_SERIAL_RX_GPIO
        int "Serial RX GPIO number"
        range ENV_GPIO_RANGE_MIN ENV_GPIO_OUT_RANGE_MAX
        default 17
        help
            GPIO number (IOxx) to receive information from bluetooth module.
            Some GPIOs are used for other purposes (flash connections, etc.) and cannot be used.
endmenu
```

## src/common-components/serial_comm/Kconfig
```kconfig
menu "OTA"

    config SERIAL_COMM_CLIENT
        bool "Enable client Serial communication"
        default y
        help
            Enables client serial communication code for sending commands to server.

    config SERIAL_COMM_SERVER
        bool "Enable server Serial communication"
        default n
        help
            Enables server serial communication code for responding to commands from client device.

endmenu
```

## src/common-components/web_config/Kconfig
```kconfig
menu "Web config"
    config MAX_WIFI_CHANNEL
        int "Last Wifi allowed channel"
        range 0 14
        default 11
        help
            What is the maximum allowed Wifi channel to be set in web config

endmenu
```

## src/common-components/wifi_connect/Kconfig
```kconfig
menu "WiFi Connect"

    config WIFI_CONNECT_SSID
        string "WiFi SSID"
        default "myssid"
        help
            SSID (network name) for the example to connect to.

    config WIFI_CONNECT_PASSWORD
        string "WiFi Password"
        default "mypassword"
        help
            WiFi password (WPA or WPA2) for the example to use.
            Can be left blank if the network has no security set.

    config WIFI_CONN_MAX_RETRY
        int "Maximum retry"
        default 6
        help
            Set the Maximum retry to avoid station reconnecting to the AP unlimited,
            in case the AP is really inexistent.

    choice WIFI_CONNECT_SCAN_METHOD
        prompt "WiFi Scan Method"
        default WIFI_CONNECT_SCAN_METHOD_ALL_CHANNEL
        help
            WiFi scan method:

            If "Fast" is selected, scan will end after find SSID match AP.

            If "All Channel" is selected, scan will end after scan all the channel.

        config WIFI_CONNECT_SCAN_METHOD_FAST
            bool "Fast"
        config WIFI_CONNECT_SCAN_METHOD_ALL_CHANNEL
            bool "All Channel"
    endchoice

    menu "WiFi Scan threshold"
        config WIFI_CONNECT_SCAN_RSSI_THRESHOLD
            int "WiFi minimum rssi"
            range -127 0

            default -127
            help
                The minimum rssi to accept in the scan mode.

        choice WIFI_CONNECT_SCAN_AUTH_MODE_THRESHOLD
            prompt "WiFi Scan auth mode threshold"
            default WIFI_CONNECT_AUTH_OPEN
            help
                The weakest authmode to accept in the scan mode.

            config WIFI_CONNECT_AUTH_OPEN
                bool "OPEN"
            config WIFI_CONNECT_AUTH_WEP
                bool "WEP"
            config WIFI_CONNECT_AUTH_WPA_PSK
                bool "WPA PSK"
            config WIFI_CONNECT_AUTH_WPA2_PSK
                bool "WPA2 PSK"
            config WIFI_CONNECT_AUTH_WPA_WPA2_PSK
                bool "WPA WPA2 PSK"
            config WIFI_CONNECT_AUTH_WPA2_ENTERPRISE
                bool "WPA2 ENTERPRISE"
            config WIFI_CONNECT_AUTH_WPA3_PSK
                bool "WPA3 PSK"
            config WIFI_CONNECT_AUTH_WPA2_WPA3_PSK
                bool "WPA2 WPA3 PSK"
            config WIFI_CONNECT_AUTH_WAPI_PSK
                bool "WAPI PSK"
        endchoice
    endmenu

    choice WIFI_CONNECT_AP_SORT_METHOD
        prompt "WiFi Connect AP Sort Method"
        default WIFI_CONNECT_AP_BY_SIGNAL
        help
            WiFi connect AP sort method:

            If "Signal" is selected, Sort matched APs in scan list by RSSI.

            If "Security" is selected, Sort matched APs in scan list by security mode.

        config WIFI_CONNECT_AP_BY_SIGNAL
            bool "Signal"
        config WIFI_CONNECT_AP_BY_SECURITY
            bool "Security"
    endchoice

    config WIFI_CONNECT_AP_DEFAULT_PASSWORD
        string "Default WiFi AP Password"
        default "mypassword"
        help
            Default WiFi password (WPA or WPA2) for the example to use.
            Can be left blank if the network has no security set.
    
    config WIFI_CONNECT_AP_DEFAULT_CHANNEL
        int "Default WiFi AP channel"
        range 1 13
        default 1
        help
            Default WiFi channel (network channel) for the AP to use.
    
    config WIFI_CONNECT_AP_DEFAULT_MAX_CONNECTION
        int "Default WiFi AP Max connections"
        range 1 255
        default 4
        help
            Default Max number of stations allowed to connect in.

endmenu
```

## src/distance-testing/sdkconfig.defaults
```kconfig
# General settings

CONFIG_ESPTOOLPY_FLASHSIZE_4MB=y
CONFIG_ESPTOOLPY_FLASHSIZE="4MB"

# WIFI
CONFIG_ESP_WIFI_FTM_ENABLE=y
```

## src/esp32-logging/components/ota/Kconfig
```kconfig
menu "Example Configuration"

    config OTA_FIRMWARE_UPGRADE_URL
        string "Firmware Upgrade URL"
        default "https://192.168.2.106:8070/hello_world.bin"
        help
            URL of server which hosts the firmware image.

    config OTA_SKIP_COMMON_NAME_CHECK
        bool "Skip server certificate CN fieldcheck"
        default n
        help
            This allows you to skip the validation of OTA server certificate CN field.

    config OTA_SKIP_VERSION_CHECK
        bool "Skip firmware version check"
        default n
        help
            This allows you to skip the firmware version check.

    config OTA_OTA_RECV_TIMEOUT
        int "OTA Receive Timeout"
        default 5000
        help
            Maximum time for reception

    config OTA_ENABLE_PARTIAL_HTTP_DOWNLOAD
        bool "Enable partial HTTP download"
        default n
        help
            This enables use of Range header in esp_https_ota component.
            Firmware image will be downloaded over multiple HTTP requests.

    config OTA_HTTP_REQUEST_SIZE
        int "HTTP request size"
        default MBEDTLS_SSL_IN_CONTENT_LEN
        depends on OTA_ENABLE_PARTIAL_HTTP_DOWNLOAD
        help
            This options specifies HTTP request size. Number of bytes specified
            in this option will be downloaded in single HTTP request.
endmenu
```

## src/esp32-s2-testing/web-console/sdkconfig.defaults
```kconfig
CONFIG_HTTPD_WS_SUPPORT=y
CONFIG_ESP_WIFI_FTM_ENABLE=y
CONFIG_ESP_WIFI_FTM_INITIATOR_SUPPORT=y
CONFIG_ESP_WIFI_FTM_RESPONDER_SUPPORT=y
```

## src/example-project/sdkconfig.defaults
```kconfig
# Target
CONFIG_IDF_TARGET="esp32s3"

# General settings

CONFIG_ESPTOOLPY_FLASHSIZE_16MB=y

CONFIG_PARTITION_TABLE_CUSTOM=y
CONFIG_PARTITION_TABLE_CUSTOM_FILENAME="partitions.csv"
CONFIG_PARTITION_TABLE_FILENAME="partitions.csv"

# Fix warnings in esp-idf
#CONFIG_COMPILER_DISABLE_GCC12_WARNINGS=y

# WIFI
CONFIG_ESP_WIFI_FTM_ENABLE=y

# WiFi Connect
CONFIG_WIFI_CONN_MAX_RETRY=3

# IMF
# Uncomment only one line according to which device type this project will be flashed to
CONFIG_IMF_STATION_DEVICE=y  # uncomment this for STATION device
# CONFIG_IMF_MOBILE_DEVICE=y # uncomment this for MOBILE device

# Serial
CONFIG_IMF_SERIAL_TX_GPIO=42
CONFIG_IMF_SERIAL_RX_GPIO=41

# Distance measurement
CONFIG_DISTANCE_FILTER_MAX_SIZE_DEFAULT=100
```

## src/finding-color/finding-color-mobile/sdkconfig.defaults
```kconfig
# Target
CONFIG_IDF_TARGET="esp32s3"

# General settings

CONFIG_ESPTOOLPY_FLASHSIZE_16MB=y

CONFIG_PARTITION_TABLE_CUSTOM=y
CONFIG_PARTITION_TABLE_CUSTOM_FILENAME="partitions.csv"
CONFIG_PARTITION_TABLE_FILENAME="partitions.csv"

# Fix warnings in esp-idf
#CONFIG_COMPILER_DISABLE_GCC12_WARNINGS=y

# WIFI
CONFIG_ESP_WIFI_FTM_ENABLE=y

# IMF
CONFIG_IMF_MOBILE_DEVICE=y
# Serial
CONFIG_IMF_SERIAL_TX_GPIO=42
CONFIG_IMF_SERIAL_RX_GPIO=41
```

## src/finding-color/finding-color-station/sdkconfig.defaults
```kconfig
# Target
CONFIG_IDF_TARGET="esp32s3"

# General settings

CONFIG_ESPTOOLPY_FLASHSIZE_4MB=y
CONFIG_ESPTOOLPY_FLASHSIZE="4MB"

CONFIG_PARTITION_TABLE_CUSTOM=y
CONFIG_PARTITION_TABLE_CUSTOM_FILENAME="partitions.csv"
CONFIG_PARTITION_TABLE_FILENAME="partitions.csv"

# Fix warnings in esp-idf
#CONFIG_COMPILER_DISABLE_GCC12_WARNINGS=y

# WIFI
CONFIG_ESP_WIFI_FTM_ENABLE=y

# IMF
CONFIG_IMF_STATION_DEVICE=y
# Serial
CONFIG_IMF_SERIAL_TX_GPIO=42
CONFIG_IMF_SERIAL_RX_GPIO=41

# Distance measurement
CONFIG_DISTANCE_FILTER_MAX_SIZE_DEFAULT=100
```

## src/finding-color/sdkconfig.defaults
```kconfig
# General settings

CONFIG_ESPTOOLPY_FLASHSIZE_4MB=y
CONFIG_ESPTOOLPY_FLASHSIZE="4MB"

CONFIG_PARTITION_TABLE_CUSTOM=y
CONFIG_PARTITION_TABLE_CUSTOM_FILENAME="partitions.csv"
CONFIG_PARTITION_TABLE_FILENAME="partitions.csv"

# Fix warnings in esp-idf
#CONFIG_COMPILER_DISABLE_GCC12_WARNINGS=y

# WIFI
CONFIG_ESP_WIFI_FTM_ENABLE=y
```
